## uboot-port/arch/mips/mach-otto/Kconfig
```kconfig
menu "Realtek Otto platforms"
	depends on ARCH_OTTO

config SYS_SOC
	default "otto"

config SOC_RTL9300
	bool
	select SUPPORT_BIG_ENDIAN
	select SUPPORTS_CPU_MIPS32_R1
	select SUPPORTS_CPU_MIPS32_R2
	help
	  Realtek RTL930x (MIPS 34Kc, 2 threads, 800 MHz).

choice
	prompt "Board select"

config TARGET_TPLINK_TL_ST1008F
	bool "TP-Link TL-ST1008F v2 (RTL9303)"
	select SOC_RTL9300

endchoice

source "board/tplink/tl-st1008f/Kconfig"

endmenu
```

## uboot-port/board/tplink/tl-st1008f/Kconfig
```kconfig
if TARGET_TPLINK_TL_ST1008F

config SYS_BOARD
	default "tl-st1008f"

config SYS_VENDOR
	default "tplink"

config SYS_CONFIG_NAME
	default "tplink_tl-st1008f"

config TEXT_BASE
	default 0x81000000

config CMD_ST1008F_DT
	bool "dt: DRAM bus/fade/crosstalk/pattern tests (SDK dt_*)"
	default y

config CMD_ST1008F_DSS
	bool "rtk dss: die speed sensor ring-oscillator counts"
	default y

config CMD_ST1008F_FLSHOW
	bool "flshow: stock flash partition table (static, read-only)"
	default y

endif
```

## uboot-port/configs/tplink_tl-st1008f_ram_defconfig
```kconfig
CONFIG_MIPS=y
CONFIG_SKIP_LOWLEVEL_INIT=y
CONFIG_TEXT_BASE=0x81000000
CONFIG_SYS_MALLOC_LEN=0x100000
CONFIG_NR_DRAM_BANKS=1
CONFIG_ENV_SIZE=0x2000
CONFIG_DEFAULT_DEVICE_TREE="tplink_tl-st1008f"
CONFIG_SYS_LOAD_ADDR=0x84f00000
CONFIG_ARCH_OTTO=y
CONFIG_BOOTDELAY=-1
CONFIG_SYS_CONSOLE_IS_IN_ENV=y
CONFIG_BOARD_EARLY_INIT_F=y
CONFIG_SYS_PROMPT="st1008f-mainline # "
CONFIG_HUSH_PARSER=y
# CONFIG_CMD_CONSOLE is not set
# CONFIG_CMD_LOADB is not set
# CONFIG_CMD_LOADS is not set
# CONFIG_CMD_FLASH is not set
# CONFIG_CMD_NET is not set
# CONFIG_CMD_NFS is not set
# CONFIG_CMD_SOURCE is not set
CONFIG_OF_CONTROL=y
CONFIG_OF_SEPARATE=y
CONFIG_ENV_IS_NOWHERE=y
# CONFIG_NET is not set
CONFIG_DM=y
CONFIG_DM_SERIAL=y
CONFIG_DM_GPIO=y
CONFIG_GPIO_REALTEK_OTTO=y
CONFIG_CMD_GPIO=y
CONFIG_BUTTON=y
CONFIG_BUTTON_GPIO=y
CONFIG_CMD_BUTTON=y
CONFIG_DM_I2C=y
CONFIG_SYS_I2C_RTL9300=y
CONFIG_DM_I2C_GPIO=y
CONFIG_DM_PCA953X=y
CONFIG_CMD_I2C=y
CONFIG_SYS_NS16550=y
# CONFIG_TOOLS_LIBCRYPTO is not set
# CONFIG_TOOLS_KWBIMAGE is not set
CONFIG_LZMA=y
CONFIG_SYS_BOOTM_LEN=0x2000000
# CONFIG_CMD_SAVEENV is not set
# CONFIG_CMD_ELF is not set
# CONFIG_CMD_XIMG is not set
CONFIG_DM_SPI=y
CONFIG_SPI_REALTEK_RTL=y
CONFIG_SPI=y
CONFIG_SPI_FLASH=y
CONFIG_DM_SPI_FLASH=y
CONFIG_SPI_FLASH_WINBOND=y
CONFIG_CMD_SF=y
CONFIG_MTD=y
CONFIG_SPI_FLASH_MTD=y
# CONFIG_SPI_FLASH_UNLOCK_ALL is not set
CONFIG_CLK=y
CONFIG_OF_BOARD_SETUP=y
CONFIG_BOARD_LATE_INIT=y
```
